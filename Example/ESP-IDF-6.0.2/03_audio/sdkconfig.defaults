## Example/ESP-IDF-6.0.2/03_audio/sdkconfig.defaults
```kconfig
CONFIG_IDF_TARGET="esp32s3"
CONFIG_ESP_DEFAULT_CPU_FREQ_MHZ_240=y
CONFIG_ESPTOOLPY_FLASHMODE_QIO=y
CONFIG_ESPTOOLPY_FLASHFREQ_80M=y
CONFIG_ESPTOOLPY_FLASHSIZE_8MB=y
CONFIG_SPIRAM=y
CONFIG_SPIRAM_MODE_OCT=y
CONFIG_IDF_EXPERIMENTAL_FEATURES=y
CONFIG_SPIRAM_SPEED_80M=y
CONFIG_SPIRAM_FETCH_INSTRUCTIONS=y
CONFIG_SPIRAM_RODATA=y

CONFIG_FREERTOS_HZ=1000
CONFIG_ESP32S3_DATA_CACHE_LINE_64B=y
CONFIG_COMPILER_OPTIMIZATION_PERF=y

CONFIG_FATFS_LFN_HEAP=y
# CONFIG_CODEC_ES8311_SUPPORT is not set
# CONFIG_CODEC_ES7210_SUPPORT is not set
# CONFIG_CODEC_ES7243_SUPPORT is not set
# CONFIG_CODEC_ES7243E_SUPPORT is not set
# CONFIG_CODEC_ES8156_SUPPORT is not set
CONFIG_CODEC_ES8389_SUPPORT=y
# CONFIG_CODEC_ES8374_SUPPORT is not set
# CONFIG_CODEC_ES8388_SUPPORT is not set
```
